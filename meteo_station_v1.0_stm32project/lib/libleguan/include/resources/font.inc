 /* * * * * * * * * * * * * * * * * * * * * * * * * * * * * * * * * *
  *          _                                                      *
  *         | |                                                     *
  *         | |     ___  __ _ _   _  __ _ _ __                      *
  *         | |    / _ \/ _` | | | |/ _` | '_ \                     *
  *         | |___|  __/ (_| | |_| | (_| | | | |                    *
  *         \_____/\___|\__, |\__,_|\__,_|_| |_|                    *
  *        ============= __/ | ==================                   *
  *                     |___/           BFH 2021                    *
  *                                                                 *
  * * * * * * * * * * * * * * * * * * * * * * * * * * * * * * * * * *
  * This software can be used by students and other personal of the *
  * Bern University of Applied Sciences under the terms of the MIT  *
  * license.                                                        *
  * For other persons this software is under the terms of the GNU   *
  * General Public License version 2.                               *
  *                                                                 *
  * Copyright &copy; 2021, Bern University of Applied Sciences.     *
  * All rights reserved.                                            *
  * * * * * * * * * * * * * * * * * * * * * * * * * * * * * * * * * */
/**
  *  @file font.inc
  *  @ingroup resources
  *  @author Nikolaij Saegesser
  *  @brief Console Font resource
  */

#pragma once

#if defined(__cplusplus)
extern "C" {
#endif


/* Includes */
#include "common/types.h"

#define CONSOLE_FONT_CHAR_WIDTH     7
#define CONSOLE_FONT_CHAR_HEIGHT    9

const static uint8_t ConsoleFont[][8] = {

    { 0x00, 0x00, 0x00, 0x00, 0x00, 0x00, 0x00, 0x00 },   ///< Character 0x00 |  ^@|
    { 0x7E, 0x81, 0xA5, 0x81, 0xBD, 0x99, 0x81, 0x7E },   ///< Character 0x01 |  ^A|
    { 0x7E, 0xFF, 0xDB, 0xFF, 0xC3, 0xE7, 0xFF, 0x7E },   ///< Character 0x02 |  ^B|
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    { 0x00, 0x00, 0x00, 0x00, 0x00, 0x00, 0x00, 0x00 },   ///< Character 0xFF |    |

};


#if defined(__cplusplus)
}
#endif
